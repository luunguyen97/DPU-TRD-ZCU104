/include/ "system-conf.dtsi"
/{
    dpu: dpu@8f000000 {
         compatible = "deephi, dpu";
         reg = <0x0 0x80000000 0x0 0x700>;
         interrupts = <0x0 106 0x4>;
         interrupt-parent = <&gic>;
         core-num = <0x1>;
     };
     dpcma: dpcma {
         compatible = "deephi,cma";
     };

};

&sdhci1 {
      no-1-8-v;
      disable-wp;
};
